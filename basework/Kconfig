## basework/Kconfig
```kconfig
menuconfig BASEWORK
    bool "Low level Base library"
    default y

if BASEWORK

rsource "os/Kconfig"

config CORTEXM_DWT
    bool "Enable watchpoint for cortexm cpu"

config BASEWORK_MEM_SIZE
    int "The memory pool size of general allocator"
    default 16384

config GTEST
    bool "The google code test framework"
    select CPLUSPLUS
    select LIB_CPLUSPLUS
    select POSIX_API
    select PTHREAD_IPC

config BASEWORK_TEST
    bool "Enable test case for basework"
    depends on GTEST
    default n


rsource "dev/Kconfig"
    
endif #BASEWORK
```

## basework/dev/Kconfig
```kconfig
menu "Block Device"
config BLKDEV_NR_BUFS
    int "The block device buffer numbers"
    range 1 20
    default 4

config BLKDEV_MAX_BLKSZ
    int "The maximum block size for block device"
    default 4096

config BLKDEV_SWAP_PERIOD
    int "Block device sync period with milliseconds"
    default 3000

config BLKDEV_HOLD_TIME
    int "Block device data hold time with millisecond"
    default 10000
    
endmenu
```

## basework/os/Kconfig
```kconfig
menu "Operation System Abstract Layer"

config OS_MAX_TIMERS
    int "The maximum timers"
    default 30
    help
        This option is limit maximum timers that can be created
        at the same time

config OS_MAX_FILES
    int "The maximum files"
    default 10
    help
        This option is limit maximu files that can be opend at
        the same time
        
endmenu
```
